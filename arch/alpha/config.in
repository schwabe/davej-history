## arch/alpha/config.in
```kconfig
#
# For a description of the syntax of this configuration file,
# see the Configure script.
#
mainmenu_name "Kernel configuration of Linux for Alpha machines"

# clear all implied options (don't want default values for those):
unset CONFIG_CROSSCOMPILE CONFIG_NATIVE
unset CONFIG_PCI CONFIG_ALPHA_EISA
unset CONFIG_ALPHA_LCA CONFIG_ALPHA_APECS CONFIG_ALPHA_CIA CONFIG_ALPHA_T2
unset CONFIG_ALPHA_PYXIS
unset CONFIG_ALPHA_EV4 CONFIG_ALPHA_EV5
unset CONFIG_ALPHA_NEED_ROUNDING_EMULATION
unset CONFIG_ALPHA_SRM CONFIG_ALPHA_SRM_SETUP

mainmenu_option next_comment
comment 'Code maturity level options'
bool 'Prompt for development and/or incomplete code/drivers' CONFIG_EXPERIMENTAL
endmenu

mainmenu_option next_comment
comment 'Loadable module support'
bool 'Enable loadable module support' CONFIG_MODULES
if [ "$CONFIG_MODULES" = "y" ]; then
   MODULES=y
   bool 'Set version information on all module symbols' CONFIG_MODVERSIONS
   bool 'Kernel daemon support (e.g. autoload of modules)' CONFIG_KERNELD
fi
endmenu

mainmenu_option next_comment
comment 'General setup'

if [ "`uname`" != "Linux" ]; then
   define_bool CONFIG_CROSSCOMPILE y
else
   define_bool CONFIG_NATIVE y
fi

choice 'Alpha system type' \
	"Avanti		CONFIG_ALPHA_AVANTI		\
	 Alpha-XL	CONFIG_ALPHA_XL			\
	 Alpha-XLT	CONFIG_ALPHA_XLT		\
	 Cabriolet	CONFIG_ALPHA_CABRIOLET		\
	 EB66		CONFIG_ALPHA_EB66		\
	 EB66+		CONFIG_ALPHA_EB66P		\
	 EB64+		CONFIG_ALPHA_EB64P		\
	 EB164		CONFIG_ALPHA_EB164		\
	 PC164		CONFIG_ALPHA_PC164		\
	 LX164		CONFIG_ALPHA_LX164		\
	 SX164		CONFIG_ALPHA_SX164		\
	 Jensen		CONFIG_ALPHA_JENSEN		\
	 Noname		CONFIG_ALPHA_NONAME		\
	 Takara		CONFIG_ALPHA_TAKARA		\
	 Mikasa		CONFIG_ALPHA_MIKASA		\
	 Noritake	CONFIG_ALPHA_NORITAKE		\
	 Alcor		CONFIG_ALPHA_ALCOR		\
	 Miata		CONFIG_ALPHA_MIATA		\
	 Sable		CONFIG_ALPHA_SABLE		\
	 AlphaBook1	CONFIG_ALPHA_BOOK1		\
	 Ruffian	CONFIG_ALPHA_RUFFIAN		\
	 Platform2000	CONFIG_ALPHA_P2K" Cabriolet

if [ "$CONFIG_ALPHA_BOOK1" = "y" ]; then
   define_bool CONFIG_ALPHA_NONAME y
fi
if [ "$CONFIG_ALPHA_NONAME" = "y" -o "$CONFIG_ALPHA_EB66" = "y" \
	-o "$CONFIG_ALPHA_EB66P" = "y" -o "$CONFIG_ALPHA_P2K" = "y" ]; then
   define_bool CONFIG_PCI y
   define_bool CONFIG_ALPHA_EV4 y
   define_bool CONFIG_ALPHA_LCA y
fi
if [ "$CONFIG_ALPHA_CABRIOLET" = "y" -o "$CONFIG_ALPHA_AVANTI" = "y" \
	-o "$CONFIG_ALPHA_EB64P" = "y" -o "$CONFIG_ALPHA_XL" = "y" ]; then
   define_bool CONFIG_PCI y
   define_bool CONFIG_ALPHA_EV4 y
   define_bool CONFIG_ALPHA_APECS y
fi
if [ "$CONFIG_ALPHA_EB164" = "y" -o "$CONFIG_ALPHA_PC164" = "y" \
	-o "$CONFIG_ALPHA_ALCOR" = "y" -o "$CONFIG_ALPHA_XLT" = "y" \
	-o "$CONFIG_ALPHA_TAKARA" = "y" ]; then
   define_bool CONFIG_PCI y
   define_bool CONFIG_ALPHA_EV5 y
   define_bool CONFIG_ALPHA_CIA y
fi
if [ "$CONFIG_ALPHA_MIKASA" = "y" -o "$CONFIG_ALPHA_NORITAKE" = "y" ]; then
   bool 'Pinnacle or Primo CPU daughtercard?' CONFIG_ALPHA_PRIMO
   if [ "$CONFIG_ALPHA_PRIMO" = "y" ]; then
      define_bool CONFIG_ALPHA_EV5 y
      define_bool CONFIG_ALPHA_CIA y
   else
      define_bool CONFIG_ALPHA_EV4 y
      define_bool CONFIG_ALPHA_APECS y
   fi
   define_bool CONFIG_PCI y
fi
if [ "$CONFIG_ALPHA_SABLE" = "y" ]; then
   bool 'EV5 or EV56 CPU daughtercard?' CONFIG_ALPHA_GAMMA
   if [ "$CONFIG_ALPHA_GAMMA" = "y" ]; then
      define_bool CONFIG_ALPHA_EV5 y
   else
      define_bool CONFIG_ALPHA_EV4 y
   fi
   define_bool CONFIG_PCI y
   define_bool CONFIG_ALPHA_T2 y
fi
if [ "$CONFIG_ALPHA_MIATA" = "y" -o "$CONFIG_ALPHA_LX164" = "y" \
	 -o "$CONFIG_ALPHA_SX164" = "y" -o "$CONFIG_ALPHA_RUFFIAN" = "y" ]; then
   define_bool CONFIG_PCI y
   define_bool CONFIG_ALPHA_EV5 y
   define_bool CONFIG_ALPHA_PYXIS y
fi
if [ "$CONFIG_ALPHA_JENSEN" = "y" ]; then
   define_bool CONFIG_ALPHA_EV4 y
fi
if [ "$CONFIG_ALPHA_EV4" = "y" ]; then
   # EV45 and older do not support all rounding modes in hw:
   define_bool CONFIG_ALPHA_NEED_ROUNDING_EMULATION y
fi

if [ "$CONFIG_ALPHA_CABRIOLET" = "y" -o "$CONFIG_ALPHA_AVANTI" = "y" \
	-o "$CONFIG_ALPHA_EB64P" = "y" -o "$CONFIG_ALPHA_JENSEN" = "y" \
	-o "$CONFIG_ALPHA_MIKASA" = "y" -o "$CONFIG_ALPHA_ALCOR" = "y" \
	-o "$CONFIG_ALPHA_SABLE" = "y" -o "$CONFIG_ALPHA_MIATA" = "y" \
	-o "$CONFIG_ALPHA_NORITAKE" = "y" -o "$CONFIG_ALPHA_PC164" = "y" \
	-o "$CONFIG_ALPHA_LX164" = "y" -o "$CONFIG_ALPHA_SX164" = "y" ]; then
   bool 'Use SRM as bootloader' CONFIG_ALPHA_SRM
   if [ "$CONFIG_EXPERIMENTAL" = "y" ]; then
      if [ "$CONFIG_ALPHA_SRM" = "y" ]; then
	 bool '  Use SRM PCI setup (EXPERIMENTAL)' CONFIG_ALPHA_SRM_SETUP
      fi
   fi
fi
if [ "$CONFIG_ALPHA_ALCOR" = "y" -o "$CONFIG_ALPHA_MIKASA" = "y" \
    -o "$CONFIG_ALPHA_SABLE" = "y" -o "$CONFIG_ALPHA_NORITAKE" = "y" ]; then
   define_bool CONFIG_ALPHA_EISA y
fi
if [ "$CONFIG_ALPHA_XL" = "y" ]; then
   define_bool CONFIG_ALPHA_AVANTI y
fi

bool 'Kernel GDB support' CONFIG_KGDB
if [ "$CONFIG_KGDB" = "y" ]; then
   bool '  Kernel tracing support' CONFIG_KGDB_TRACING
fi

bool 'Echo console messages on /dev/ttyS0 (COM1)' CONFIG_SERIAL_ECHO
if [ "$CONFIG_PCI" = "y" ]; then
   bool 'TGA Console Support' CONFIG_TGA_CONSOLE
   if [ "$CONFIG_TGA_CONSOLE" = "y" ]; then
      bool '  VGA Console Support' CONFIG_VGA_CONSOLE
   fi
   if [ "$CONFIG_EXPERIMENTAL" = "y" ]; then
      bool 'PCI bridge optimization (EXPERIMENTAL)' CONFIG_PCI_OPTIMIZE
   fi
fi
bool 'Networking support' CONFIG_NET
bool 'System V IPC' CONFIG_SYSVIPC
tristate 'Kernel support for a.out (ECOFF) binaries' CONFIG_BINFMT_AOUT
tristate 'Kernel support for ELF binaries' CONFIG_BINFMT_ELF
tristate 'Kernel support for Linux/Intel ELF binaries' CONFIG_BINFMT_EM86
endmenu

source drivers/block/Config.in

if [ "$CONFIG_NET" = "y" ]; then
   source net/Config.in
fi

mainmenu_option next_comment
comment 'SCSI support'

tristate 'SCSI support' CONFIG_SCSI

if [ "$CONFIG_SCSI" != "n" ]; then
   source drivers/scsi/Config.in
fi
endmenu

if [ "$CONFIG_NET" = "y" ]; then
   mainmenu_option next_comment
   comment 'Network device support'

   bool 'Network device support' CONFIG_NETDEVICES
   if [ "$CONFIG_NETDEVICES" = "y" ]; then
      source drivers/net/Config.in
   fi
   endmenu
fi

mainmenu_option next_comment
comment 'ISDN subsystem'

tristate 'ISDN support' CONFIG_ISDN
if [ "$CONFIG_ISDN" != "n" ]; then
   source drivers/isdn/Config.in
fi
endmenu

mainmenu_option next_comment
comment 'CD-ROM drivers (not for SCSI or IDE/ATAPI drives)'

bool 'Support non-SCSI/IDE/ATAPI drives' CONFIG_CD_NO_IDESCSI
if [ "$CONFIG_CD_NO_IDESCSI" != "n" ]; then
   source drivers/cdrom/Config.in
fi
endmenu

source fs/Config.in

source drivers/char/Config.in

mainmenu_option next_comment
comment 'Sound'

tristate 'Sound card support' CONFIG_SOUND
if [ "$CONFIG_SOUND" != "n" ]; then
   source drivers/sound/Config.in
fi
endmenu

mainmenu_option next_comment
comment 'Kernel hacking'

#bool 'Debug kmalloc/kfree' CONFIG_DEBUG_MALLOC
bool 'Kernel profiling support' CONFIG_PROFILE
if [ "$CONFIG_PROFILE" = "y" ]; then
   int ' Profile shift count' CONFIG_PROFILE_SHIFT 2
fi
bool 'Memory flooding' CONFIG_SADISTIC_KMALLOC
bool 'Socket-buffer consistency checking' CONFIG_SKB_CHECK
if [ "$CONFIG_SKB_CHECK" = "y" ]; then
   bool '  Whole-queue checking' CONFIG_SKB_CHECK_WHOLE_QUEUE
fi
endmenu

if [ "$CONFIG_TGA_CONSOLE" = "n" ]; then
   define_bool CONFIG_VGA_CONSOLE y
fi
```

## arch/i386/config.in
```kconfig
#
# For a description of the syntax of this configuration file,
# see the Configure script.
#
mainmenu_name "Linux Kernel Configuration"

mainmenu_option next_comment
comment 'Code maturity level options'
bool 'Prompt for development and/or incomplete code/drivers' CONFIG_EXPERIMENTAL
endmenu

mainmenu_option next_comment
comment 'Loadable module support'
bool 'Enable loadable module support' CONFIG_MODULES
if [ "$CONFIG_MODULES" = "y" ]; then
   bool '  Set version information on all module symbols' CONFIG_MODVERSIONS
   bool '  Kernel daemon support (e.g. autoload of modules)' CONFIG_KERNELD
fi
endmenu

mainmenu_option next_comment
comment 'General setup'

bool 'Kernel math emulation' CONFIG_MATH_EMULATION
choice 'Memory configuration' \
	"Standard	CONFIG_MEM_STD	\
	 Enterprise	CONFIG_MEM_ENT	\
	 Custom		CONFIG_MEM_SPECIAL" Standard

if [ "$CONFIG_MEM_SPECIAL" = "y" ]; then
   int ' Max physical memory in MB (must be a multiple of 4)' CONFIG_MAX_MEMSIZE 1024
fi
if [ "$CONFIG_MEM_ENT" = "y" ]; then
   define_int CONFIG_MAX_MEMSIZE 2048
fi
if [ "$CONFIG_MEM_STD" = "y" ]; then
   define_int CONFIG_MAX_MEMSIZE 1024
fi
bool 'Networking support' CONFIG_NET
bool 'Limit memory to low 16MB' CONFIG_MAX_16M
bool 'PCI bios support' CONFIG_PCI
if [ "$CONFIG_PCI" = "y" ]; then
   if [ "$CONFIG_EXPERIMENTAL" = "y" ]; then
      bool '  PCI bridge optimization (EXPERIMENTAL)' CONFIG_PCI_OPTIMIZE
   fi
fi
bool 'System V IPC' CONFIG_SYSVIPC
tristate 'Kernel support for a.out binaries' CONFIG_BINFMT_AOUT
tristate 'Kernel support for ELF binaries' CONFIG_BINFMT_ELF
if [ "$CONFIG_EXPERIMENTAL" = "y" ]; then
   tristate 'Kernel support for JAVA binaries (EXPERIMENTAL)' CONFIG_BINFMT_JAVA
fi
bool 'Compile kernel as ELF - if your GCC is ELF-GCC' CONFIG_KERNEL_ELF

choice 'Processor type' \
	"386		CONFIG_M386	\
	 486		CONFIG_M486	\
	 Pentium	CONFIG_M586	\
	 PPro		CONFIG_M686" Pentium

# Conditionally compile MTRR manipulation support
if [ "$CONFIG_M686" = "y" -o "$CONFIG_M586" = "y" ]; then
   bool 'Handle buggy SMP BIOSes with bad MTRR setup' CONFIG_MTRR
fi

bool 'Advanced Power Management BIOS support' CONFIG_APM
if [ "$CONFIG_APM" = "y" ]; then
   bool '  Ignore USER SUSPEND' CONFIG_APM_IGNORE_USER_SUSPEND
   bool '  Enable PM at boot time' CONFIG_APM_DO_ENABLE
   bool '  Make CPU Idle calls when idle' CONFIG_APM_CPU_IDLE
   bool '  Enable console blanking using APM' CONFIG_APM_DISPLAY_BLANK
   bool '  Power off on shutdown' CONFIG_APM_POWER_OFF
   bool '  Ignore multiple suspend' CONFIG_APM_IGNORE_MULTIPLE_SUSPEND
fi

endmenu

source drivers/block/Config.in

if [ "$CONFIG_NET" = "y" ]; then
   source net/Config.in
fi

mainmenu_option next_comment
comment 'SCSI support'

tristate 'SCSI support' CONFIG_SCSI

if [ "$CONFIG_SCSI" != "n" ]; then
   source drivers/scsi/Config.in
fi
endmenu

if [ "$CONFIG_NET" = "y" ]; then
   mainmenu_option next_comment
   comment 'Network device support'

   bool 'Network device support' CONFIG_NETDEVICES
   if [ "$CONFIG_NETDEVICES" = "y" ]; then
      source drivers/net/Config.in
   fi
   endmenu
fi

mainmenu_option next_comment
comment 'ISDN subsystem'

tristate 'ISDN support' CONFIG_ISDN
if [ "$CONFIG_ISDN" != "n" ]; then
   source drivers/isdn/Config.in
fi
endmenu

mainmenu_option next_comment
comment 'CD-ROM drivers (not for SCSI or IDE/ATAPI drives)'

bool 'Support non-SCSI/IDE/ATAPI CDROM drives' CONFIG_CD_NO_IDESCSI
if [ "$CONFIG_CD_NO_IDESCSI" != "n" ]; then
   source drivers/cdrom/Config.in
fi
endmenu

source fs/Config.in

source drivers/char/Config.in

mainmenu_option next_comment
comment 'Sound'

tristate 'Sound card support' CONFIG_SOUND
if [ "$CONFIG_SOUND" != "n" ]; then
   source drivers/sound/Config.in
fi
endmenu

mainmenu_option next_comment
comment 'Kernel hacking'

#bool 'Debug kmalloc/kfree' CONFIG_DEBUG_MALLOC
bool 'Kernel profiling support' CONFIG_PROFILE
if [ "$CONFIG_PROFILE" = "y" ]; then
   int ' Profile shift count' CONFIG_PROFILE_SHIFT 2
fi
bool 'Memory flooding' CONFIG_SADISTIC_KMALLOC
bool 'Socket-buffer consistency checking' CONFIG_SKB_CHECK
if [ "$CONFIG_SKB_CHECK" = "y" ]; then
   bool '  Whole-queue checking' CONFIG_SKB_CHECK_WHOLE_QUEUE
fi
endmenu
```
